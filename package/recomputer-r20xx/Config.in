## package/recomputer-r20xx/Config.in
```kconfig
config BR2_PACKAGE_RECOMPUTER_R20XX
	bool "recomputer-r20xx"
	select BR2_PACKAGE_HOST_DTC
	help
	  Device tree overlays for the Seeed Studio reComputer Industrial
	  R20xx (Raspberry Pi CM5).

	  https://github.com/Seeed-Studio/seeed-linux-dtoverlays
```

## package/rtc-pcf8563w/Config.in
```kconfig
config BR2_PACKAGE_RTC_PCF8563W
	bool "rtc-pcf8563w"
	depends on BR2_LINUX_KERNEL
	help
	  Seeed Studio fork of the PCF8563 RTC driver that also exposes
	  the RTC timer as a hardware watchdog.

	  https://github.com/Seeed-Studio/seeed-linux-dtoverlays

comment "rtc-pcf8563w needs a Linux kernel to be built"
	depends on !BR2_LINUX_KERNEL
```
